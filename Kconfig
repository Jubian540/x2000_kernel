## Kconfig
```kconfig
#
# For a description of the syntax of this configuration file,
# see Documentation/kbuild/kconfig-language.txt.
#
mainmenu "Linux/$ARCH $KERNELVERSION Kernel Configuration"

config SRCARCH
	string
	option env="SRCARCH"
config OUTSIDE_BUILD
	string
	option env="OUTSIDE_BUILD"
source "arch/$SRCARCH/Kconfig"
source "$OUTSIDE_BUILD/Kconfig"
```

## arch/mips/xburst2/soc-x2500/Kconfig.DT
```kconfig
config DT_GANDER_V10
	bool "x2500 gander_v10"
config DT_DARWIN_V14
	bool "x2500 darwin_v14"
config DT_HIPPO_V10
	bool "x2500 hippo_v10"
```

## drivers/clk/ingenic-v2/Kconfig
```kconfig
config COMMON_CLK_INGENIC
	bool
	depends on MACH_XBURST || MACH_XBURST2
	select MFD_SYSCON
	select COMMON_CLK
	select INGENIC_CLK_DEBUG_FS

config COMMON_CLK_INGENIC_X2500
	bool
	depends on MACH_XBURST || MACH_XBURST2
	select MFD_SYSCON
	select COMMON_CLK
	select INGENIC_CLK_DEBUG_FS

config INGENIC_CLK_DEBUG_FS
	bool
	depends on DEBUG_FS
	help
	  enable ingenic common clock debugfs

config CLK_X2000_V12
	bool
	depends on SOC_X2000_V12
	select COMMON_CLK_INGENIC
	help
	  build the ingenic x2000-v12 soc clock driver.

config CLK_X2100
	bool
	depends on SOC_X2100
	select COMMON_CLK_INGENIC
	help
	  build the ingenic x2000-v12 soc clock driver.


config CLK_M300
	bool
	depends on SOC_M300
	select COMMON_CLK_INGENIC
	help
	  build the ingenic m300 soc clock driver.


config CLK_X2500
	bool
	depends on SOC_X2500
	select COMMON_CLK_INGENIC
	help
	  build the ingenic x2500 soc clock driver.

config CLK_X1600
	bool
	depends on SOC_X1600
	select COMMON_CLK_INGENIC
	help
	  build the ingenic x1600 soc clock driver.
```

## drivers/dma/ingenic/Kconfig
```kconfig
# DMA engine configuration for ingenic
config INGENIC_DMA_RECEIVE_DXTERNAL_DECIDE
	tristate "ingenic dma receiving data is externally determined"
	depends on INGENIC_PDMAC && SOC_X1600
	default n
	---help---
	How much data is received is externally determined
```

## drivers/media/platform/ingenic-vcodec/Kconfig
```kconfig
config INGENIC_HELIX
	tristate "ingenic video helix"
	depends on VIDEO_INGENIC_VCODEC
config INGENIC_FELIX
	tristate "ingenic video felix"
	depends on VIDEO_INGENIC_VCODEC
```

## drivers/video/fbdev/ingenic/fb_stage/Kconfig
```kconfig
menuconfig FB_INGENIC_STAGE
	tristate "Ingenic Framebuffer Driver for stage"
	depends on FB_INGENIC
	select FB_INGENIC_DISPLAYS_STAGE
	select FB_CFB_FILLRECT
	select FB_CFB_COPYAREA
	select FB_CFB_IMAGEBLIT
	help
	  Framebuffer support for the Version 12 DPU SoC.

source "drivers/video/fbdev/ingenic/fb_stage/displays/Kconfig"
```

## drivers/video/ingenic_bscaler/Kconfig
```kconfig
config JZ_BSCALER
    bool "jz bscaler driver"
    depends on SOC_X2500
    default n
```

## drivers/video/ingenic_i2d/Kconfig
```kconfig
menuconfig JZ_I2D
    bool "JZ I2D Driver"
    default n
    depends on SOC_X2500
    help
        Support for Ingenic i2d Driver

config INGENIC_I2D
	tristate "Ingenic I2D Driver"
	depends on JZ_I2D
	default n
	help
	  Support for Ingenic i2d  operations.
```

## drivers/video/ingenic_ipu/Kconfig
```kconfig
menuconfig JZ_IPU
	bool "JZ ipu unit"
	default n

config INGENIC_IPU
	tristate "Ingenic IPU Driver"
	depends on JZ_IPU
	default n
	help
	  Support for Ingenic ipu operations.

config INGENIC_DRAWBOX
	tristate "Ingenic draw box Driver"
	depends on JZ_IPU
	default n
	help
	  Support for Ingenic ipu operations.
```
